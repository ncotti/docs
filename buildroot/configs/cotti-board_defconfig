## buildroot/configs/cotti-board_defconfig
```kconfig
BR2_arm=y
BR2_cortex_a8=y
BR2_TOOLCHAIN_EXTERNAL=y
BR2_TOOLCHAIN_EXTERNAL_BOOTLIN=y
BR2_TOOLCHAIN_EXTERNAL_BOOTLIN_ARMV7_EABIHF_GLIBC_STABLE=y
BR2_GLOBAL_PATCH_DIR="$(BR2_EXTERNAL_COTTI_PATH)/board/cotti/cotti-board/patches/"
BR2_ROOTFS_OVERLAY="$(BR2_EXTERNAL_COTTI_PATH)/board/cotti/cotti-board/rootfs_overlay/"
BR2_ROOTFS_POST_BUILD_SCRIPT="$(BR2_EXTERNAL_COTTI_PATH)/board/cotti/cotti-board/post_build.sh"
BR2_ROOTFS_POST_IMAGE_SCRIPT="$(BR2_EXTERNAL_COTTI_PATH)/board/cotti/cotti-board/post_image.sh"
BR2_LINUX_KERNEL=y
BR2_LINUX_KERNEL_USE_CUSTOM_CONFIG=y
BR2_LINUX_KERNEL_CUSTOM_CONFIG_FILE="$(BR2_EXTERNAL_COTTI_PATH)/board/cotti/cotti-board/linux.config"
BR2_LINUX_KERNEL_DTS_SUPPORT=y
BR2_LINUX_KERNEL_INTREE_DTS_NAME="ti/omap/am335x-boneblack-wireless"
BR2_LINUX_KERNEL_NEEDS_HOST_OPENSSL=y
BR2_PACKAGE_NANO=y
BR2_TARGET_UBOOT=y
BR2_TARGET_UBOOT_BOARD_DEFCONFIG="am335x_evm"
# BR2_TARGET_UBOOT_FORMAT_BIN is not set
BR2_TARGET_UBOOT_FORMAT_IMG=y
BR2_TARGET_UBOOT_SPL=y
BR2_TARGET_UBOOT_SPL_NAME="MLO"
BR2_TARGET_UBOOT_CUSTOM_MAKEOPTS="DEVICE_TREE=am335x-boneblack-wireless"
BR2_PACKAGE_NINVADERS=y
```

## embedded/beaglebone_black/buildroot/configs/cotti-board_defconfig
```kconfig
BR2_arm=y
BR2_cortex_a8=y
BR2_TOOLCHAIN_EXTERNAL=y
BR2_TOOLCHAIN_EXTERNAL_BOOTLIN=y
BR2_TOOLCHAIN_EXTERNAL_BOOTLIN_ARMV7_EABIHF_MUSL_STABLE=y
BR2_GLOBAL_PATCH_DIR="$(BR2_EXTERNAL_COTTI_PATH)/board/cotti/cotti-board/patches/"
BR2_TARGET_GENERIC_HOSTNAME="cotti"
BR2_TARGET_GENERIC_ISSUE="Cotti's BBB with Buildroot!"
BR2_ROOTFS_OVERLAY="$(BR2_EXTERNAL_COTTI_PATH)/board/cotti/cotti-board/rootfs_overlay/"
BR2_ROOTFS_PRE_BUILD_SCRIPT="$(BR2_EXTERNAL_COTTI_PATH)/board/cotti/cotti-board/pre_build.sh"
BR2_ROOTFS_POST_BUILD_SCRIPT="$(BR2_EXTERNAL_COTTI_PATH)/board/cotti/cotti-board/post_build.sh"
BR2_ROOTFS_POST_IMAGE_SCRIPT="$(BR2_EXTERNAL_COTTI_PATH)/board/cotti/cotti-board/post_image.sh"
BR2_LINUX_KERNEL=y
BR2_LINUX_KERNEL_USE_CUSTOM_CONFIG=y
BR2_LINUX_KERNEL_CUSTOM_CONFIG_FILE="$(BR2_EXTERNAL_COTTI_PATH)/board/cotti/cotti-board/linux.config"
BR2_LINUX_KERNEL_NEEDS_HOST_OPENSSL=y
BR2_PACKAGE_BUSYBOX_CONFIG="$(BR2_EXTERNAL_COTTI_PATH)/board/cotti/cotti-board/busybox.config"
BR2_TARGET_UBOOT=y
BR2_TARGET_UBOOT_USE_CUSTOM_CONFIG=y
BR2_TARGET_UBOOT_CUSTOM_CONFIG_FILE="$(BR2_EXTERNAL_COTTI_PATH)/board/cotti/cotti-board/uboot.config"
# BR2_TARGET_UBOOT_FORMAT_BIN is not set
BR2_TARGET_UBOOT_FORMAT_IMG=y
BR2_TARGET_UBOOT_SPL=y
BR2_TARGET_UBOOT_SPL_NAME="MLO"
BR2_TARGET_UBOOT_CUSTOM_MAKEOPTS="EXT_DTB=$(BR2_EXTERNAL_COTTI_PATH)/board/cotti/cotti-board/dts/am335x-boneblack.dtb"
BR2_PACKAGE_HOST_DTC=y
BR2_PACKAGE_NINVADERS=y
```

## embedded/beaglebone_black/buildroot/package/ninvaders/Config.in
```kconfig
menuconfig BR2_PACKAGE_NINVADERS
    bool "nInvaders"
    select BR2_PACKAGE_NCURSES
    help
        A custom package created by Cotti.
if BR2_PACKAGE_NINVADERS

config BR2_NINVADERS_SOME_CONFIG
    bool "Some config related to nInvaders"
    default n
endif
```

## kconfig/Kconfig
```kconfig
mainmenu "Cotti's menuconfig"

comment "Printfs configuration"

config FIRST_PRINTF_TEXT
    string "Text to be shown in the code's first \"printf()\""
    default "Hello world!"
    help
        This is the text that will be printed in the first call to
        "printf()" inside the main() function.

menuconfig ENABLE_SECOND_PRINTF
    bool "Enable second printf()"
    default n
    help
        Enables a second "printf()" after the first one.

if ENABLE_SECOND_PRINTF

    config SECOND_PRINTF_TEXT
        string "Text to be shown in the code's second \"printf()\""
        default "This second printf is optional."

endif

menu "Math operation"

    config MATH_FIRST_OPERAND
        int "First operand"
        default 10

    config MATH_SECOND_OPERAND
        int "Second operand"
        default 5

    choice
        bool "Math operation to perform"

        config MATH_OPERATION_ADD
            bool "Addition"

        config MATH_OPERATION_SUB
            bool "Subtraction"

        config MATH_OPERATION_MUL
            bool "Multiplication"

    endchoice

endmenu

comment "Compiler configuration"

config USE_CUSTOM_CFLAGS
    bool "Use custom gcc C flags"
    default n
    imply CFLAGS_OPT
    select CFLAGS_WALL


config CFLAGS_OPT
    bool "Compile with optimization enabled -O3"
    depends on USE_CUSTOM_CFLAGS
    default n

config CFLAGS_WALL
    bool "Compile with all warnings enabled -Wall"
    depends on USE_CUSTOM_CFLAGS
    default n


config GENERATE_MEMORY_MAP
    bool "Generate a memory map"
    default n

config LDFLAGS_MEMORY_MAP
    string "Name of the memory map"
    default ""
    depends on GENERATE_MEMORY_MAP
```
